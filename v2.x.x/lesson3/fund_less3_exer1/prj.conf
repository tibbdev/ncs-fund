## CMakeLists.txt
```
cmake_minimum_required(VERSION 3.20.0)
find_package(Zephyr REQUIRED HINTS ${ZEPHYR_BASE})
project(hello_world)
target_sources(app PRIVATE src/main.c)
target_sources_ifdef(CONFIG_MYFUNCTION app PRIVATE src/func.c)
```

## Kconfig
```
source "Kconfig.zephyr"

config MYFUNCTION
    bool "Enable my sum function"
    default n
```

## prj.conf
```kconfig
CONFIG_MYFUNCTION=n
```

## nrf52833dk_nrf52833.overlay
```dts
// To get started, press Ctrl+Space to bring up the completion menu and view the available nodes.

// You can also use the buttons in the sidebar to perform actions on nodes.
// Actions currently available include:

// * Enabling / disabling the node
// * Adding the bus to a bus
// * Removing the node
// * Connecting ADC channels

// For more help, browse the DeviceTree documentation at https://docs.zephyrproject.org/latest/guides/dts/index.html
// You can also visit the nRF DeviceTree extension documentation at https://nrfconnect.github.io/vscode-nrf-connect/devicetree/nrfdevicetree.html

&uart0
{
    current-speed = <9600>;
};
```

## src/main.c
```c
#include <zephyr/kernel.h>
#include <zephyr/sys/printk.h>

#ifdef CONFIG_MYFUNCTION
    #include "func.h"
#endif

void main(void)
{
    #ifdef CONFIG_MYFUNCTION
        int a = 1;
        int b = 2;
        int temp;
    #endif

    while(1)
    {
        #ifdef CONFIG_MYFUNCTION
            printk("\r\nThe sum of %d and %d is %d", a, b, sum(a, b));
            temp = a;
            a = sum(a, b) % 512;
            b++;
        #else
            printk("\r\nMYFUNCTION not enabled");
        #endif
        k_msleep(1000);
    }
}
```

## src/func.c
```c
#include "func.h"

int sum(int a, int b)
{
    return a+b;
}
```

## src/func.h
```c
#pragma once

// returns the arithmetic sum of 'a' and 'b'
int sum(int a, int b);
```
